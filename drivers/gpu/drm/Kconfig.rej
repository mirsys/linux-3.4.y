## drivers/gpu/drm/Kconfig.rej
```kconfig
--- drivers/gpu/drm/Kconfig
+++ drivers/gpu/drm/Kconfig
@@ -175,7 +175,7 @@ config DRM_VIA
 config DRM_MALI
 	tristate "Mali DRM supprt"
 	depends on DRM
-	depends on MALI
+	depends on MALI400
 	help
 	  Choose this option if you have a Mali 200 or Mali 400 gpu
 	  If M is selected the module will be called mali_drm.
```

## drivers/video/Kconfig.rej
```kconfig
--- drivers/video/Kconfig
+++ drivers/video/Kconfig
@@ -25,7 +25,7 @@ source "drivers/gpu/stub/Kconfig"
 
 source "drivers/gpu/ion/Kconfig"
 
-source "drivers/gpu/mali/Kconfig"
+source "drivers/gpu/mali_r3p2-01rel2/Kconfig"
 
 config VGASTATE
        tristate
@@ -290,7 +290,7 @@ config FB_SUNXI_RESERVED_MEM
 
 config FB_SUNXI_UMP
 	bool "Enable FB/UMP Integration"
-	depends on MALI && FB_SUNXI
+	depends on MALI400 && FB_SUNXI
 	default y
 
 config FB_SUNXI_LCD
```
